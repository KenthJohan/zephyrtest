## CMakeLists.txt
```
# SPDX-License-Identifier: Apache-2.0

cmake_minimum_required(VERSION 3.13.1)
include($ENV{ZEPHYR_BASE}/cmake/app/boilerplate.cmake NO_POLICY_SCOPE)
project(st_ble_sensor)

FILE(GLOB app_sources src/*.c)
target_sources(app PRIVATE
  ${app_sources}
  )

# Add your source file to the "app" target. This must come after
# the boilerplate code, which defines the target.
target_sources(app PRIVATE src/main.c)
```

## prj.conf
```kconfig
CONFIG_BT=y
CONFIG_BT_DEBUG_LOG=y
CONFIG_BT_PERIPHERAL=y
CONFIG_BT_DEVICE_NAME="johandev"
CONFIG_BT_GATT_CLIENT=y
CONFIG_BT_GATT_DIS=y
CONFIG_BT_GATT_DIS_PNP=y
CONFIG_BT_GATT_BAS=y
CONFIG_BT_DEBUG_LOG=y
CONFIG_LOG=y
CONFIG_LOG_BUFFER_SIZE=2048
CONFIG_PWM=y
CONFIG_PWM_STM32_2=y
CONFIG_GPIO=y
CONFIG_SPI=y
CONFIG_LOG_BACKEND_SHOW_COLOR=y
CONFIG_ASSERT=y
CONFIG_STDOUT_CONSOLE=y
CONFIG_DEBUG=y
CONFIG_PRINTK=y
CONFIG_ASSERT_VERBOSE=y
```

## src/main.c
```c
#include <stddef.h>
#include <string.h>
#include <stdio.h>
#include <errno.h>

#include <zephyr.h>
#include <zephyr/types.h>

#include <sys/printk.h>
#include <sys/byteorder.h>
#include <sys/util.h>
#include <sys/__assert.h>

#include <devicetree.h>

#include <device.h>

#include <logging/log.h>

#include <drivers/pwm.h>
#include <drivers/spi.h>
#include <drivers/gpio.h>

#include <bluetooth/bluetooth.h>
#include <bluetooth/hci.h>
#include <bluetooth/conn.h>
#include <bluetooth/uuid.h>
#include <bluetooth/gatt.h>



#include "button_svc.h"
#include "led_svc.h"
#include "tmc2130.h"


LOG_MODULE_REGISTER(main);




enum app_cmd
{
	APP_CMD_STANDSTILL,
	APP_CMD_FORWARD,
	APP_CMD_BACKWARD,
	APP_CMD_DEMORUN,
	APP_CMD_CONTINUE,
};

static enum app_cmd cmd = APP_CMD_STANDSTILL;



extern u16_t but_val;
extern struct device *led_dev;
extern bool led_state;

/* ST Custom Service  */
static struct bt_uuid_128 service_stepper_uuid = BT_UUID_INIT_128(
	0x8f, 0xe5, 0xb3, 0xd5, 0x2e, 0x7f, 0x4a, 0x98,
	0x2a, 0x48, 0x7a, 0xcc, 0x40, 0xfe, 0x00, 0x00);

/* My Custom Service  */
static struct bt_uuid_128 service_helloworld_uuid = BT_UUID_INIT_128(
	0x8f, 0xe5, 0xb3, 0xd6, 0x2e, 0x7f, 0x4a, 0x98,
	0x2a, 0x48, 0x7a, 0xcc, 0x40, 0xfe, 0x00, 0x00);
	

#ifndef CONFIG_BT_DEVICE_NAME
#define CONFIG_BT_DEVICE_NAME "Unknown"
#endif

#define DEVICE_NAME CONFIG_BT_DEVICE_NAME
#define DEVICE_NAME_LEN (sizeof(DEVICE_NAME) - 1)
#define ADV_LEN 12

/* Advertising data */
static u8_t manuf_data[ADV_LEN] = {
	0x01 /*SKD version */,
	0x83 /* STM32WB - P2P Server 1 */,
	0x00 /* GROUP A Feature  */,
	0x00 /* GROUP A Feature */,
	0x00 /* GROUP B Feature */,
	0x00 /* GROUP B Feature */,
	0x00, /* BLE MAC start -MSB */
	0x00,
	0x00,
	0x00,
	0x00,
	0x00, /* BLE MAC stop */
};

static const struct bt_data ad[] = {
	BT_DATA_BYTES(BT_DATA_FLAGS, (BT_LE_AD_GENERAL | BT_LE_AD_NO_BREDR)),
	BT_DATA(BT_DATA_NAME_COMPLETE, DEVICE_NAME, DEVICE_NAME_LEN),
	BT_DATA(BT_DATA_MANUFACTURER_DATA, manuf_data, ADV_LEN)
};

/* BLE connection */
struct bt_conn *conn;
/* Notification state */
volatile bool notify_enable;

static void mpu_ccc_cfg_changed(const struct bt_gatt_attr *attr, u16_t value)
{
	ARG_UNUSED(attr);
	notify_enable = (value == BT_GATT_CCC_NOTIFY);
	//bt_addr_to_str (attr->uuid)
	//BT_DBG ("Ge");

	//char buf [128];
	//bt_uuid_to_str (attr->uuid, buf, 128);
	//printk("Discovered attribute - uuid: %s, handle: %u\n", bt_uuid_str(attr->uuid), attr->handle);

	//LOG_INF("Notification %p : %s", log_strdup (buf), notify_enable ? "enabled" : "disabled");
	LOG_INF("Notification %i : %s", attr->handle, notify_enable ? "enabled" : "disabled");
}







struct tmc2130 tmc;






static ssize_t recv_tmc_dir (struct bt_conn *conn, const struct bt_gatt_attr *attr, const void *buf, u16_t len, u16_t offset, u8_t flags)
{
	uint8_t const * v = buf;
	tmc2130_set_dir (&tmc, v[0]);
	LOG_INF ("Changing DIR to %i", tmc.flags & TMC2130_DIR_FLAG ? 1 : 0);
	return 0;
}

static ssize_t recv_tmc_en (struct bt_conn *conn, const struct bt_gatt_attr *attr, const void *buf, u16_t len, u16_t offset, u8_t flags)
{
	uint8_t const * v = buf;
	tmc2130_set_en (&tmc, v[0]);
	LOG_INF ("Changing EN to %i", tmc.flags & TMC2130_EN_FLAG ? 1 : 0);
	return 0;
}

static ssize_t recv_tmc_period (struct bt_conn *conn, const struct bt_gatt_attr *attr, const void *buf, u16_t len, u16_t offset, u8_t flags)
{
	u32_t const * u32 = buf;
	tmc2130_set_period (&tmc, sys_cpu_to_le32 (*u32));
	LOG_INF ("Changing period to %u", tmc.period);
	return 0;
}

static ssize_t recv_tmc_pulse (struct bt_conn *conn, const struct bt_gatt_attr *attr, const void *buf, u16_t len, u16_t offset, u8_t flags)
{
	u32_t const * u32 = buf;
	tmc2130_set_pulse (&tmc, sys_cpu_to_le32 (*u32));
	LOG_INF ("Changing pulse to %u", tmc.pulse);
	return 0;
}

static ssize_t recv_tmc_reg (struct bt_conn *conn, const struct bt_gatt_attr *attr, const void *buf, u16_t len, u16_t offset, u8_t flags)
{
	tmc2130_set_en (&tmc, 0);
	u32_t data1;
	u32_t data2;
	tmc2130_read (&tmc, REG_GSTAT, &data1);
	tmc2130_read (&tmc, REG_DRVSTATUS, &data2);
	tmc2130_info_DRVSTATUS (data2);
	tmc2130_write (&tmc, WRITE_FLAG|REG_CHOPCONF, 0x00008008UL);
	tmc2130_set_en (&tmc, 1);
	return 0;
}

static ssize_t demorun (struct bt_conn *conn, const struct bt_gatt_attr *attr, const void *buf, u16_t len, u16_t offset, u8_t flags)
{
	cmd = APP_CMD_DEMORUN;
	return 0;
}


static ssize_t read_u32 (struct bt_conn *conn, const struct bt_gatt_attr *attr,void *buf, u16_t len, u16_t offset)
{
	const u32_t *u32 = attr->user_data;
	u32_t value = sys_cpu_to_le32(*u32);
	return bt_gatt_attr_read(conn, attr, buf, len, offset, &value, sizeof(value));
}


static struct bt_gatt_cpf cha_format_value =
{
	8, //<Enumeration key="8" value="unsigned 32-bit integer"/>
	0x00,
	0x2703,//0x2703	time (second)	org.bluetooth.unit.time.second
	0x01,
	0x0000
};


BT_GATT_SERVICE_DEFINE 
(
service_stepper,
BT_GATT_PRIMARY_SERVICE (&service_stepper_uuid),
BT_GATT_CHARACTERISTIC  (BT_UUID_DECLARE_16(0x2A56), BT_GATT_CHRC_READ | BT_GATT_CHRC_WRITE_WITHOUT_RESP, BT_GATT_PERM_WRITE, NULL, recv_tmc_dir, (void *)1),
BT_GATT_CUD             ("Pin DIR", BT_GATT_PERM_READ),
BT_GATT_CHARACTERISTIC  (BT_UUID_DECLARE_16(0x2A56), BT_GATT_CHRC_READ | BT_GATT_CHRC_WRITE_WITHOUT_RESP, BT_GATT_PERM_WRITE, NULL, recv_tmc_en, (void *)1),
BT_GATT_CUD             ("Pin EN", BT_GATT_PERM_READ),
BT_GATT_CHARACTERISTIC  (BT_UUID_DECLARE_16(0x2A56), BT_GATT_CHRC_READ | BT_GATT_CHRC_WRITE_WITHOUT_RESP, BT_GATT_PERM_WRITE|BT_GATT_PERM_READ, read_u32, recv_tmc_period, &tmc.period),
BT_GATT_CPF             (&cha_format_value),
BT_GATT_CUD             ("Pin STEP period", BT_GATT_PERM_READ),
BT_GATT_CHARACTERISTIC  (BT_UUID_DECLARE_16(0x2A56), BT_GATT_CHRC_READ | BT_GATT_CHRC_WRITE_WITHOUT_RESP, BT_GATT_PERM_WRITE|BT_GATT_PERM_READ, read_u32, recv_tmc_pulse, &tmc.pulse),
BT_GATT_CPF             (&cha_format_value),
BT_GATT_CUD             ("Pin STEP pulse", BT_GATT_PERM_READ),
BT_GATT_CHARACTERISTIC  (BT_UUID_DECLARE_16(0x2A56), BT_GATT_CHRC_READ | BT_GATT_CHRC_WRITE_WITHOUT_RESP, BT_GATT_PERM_WRITE, NULL, recv_tmc_reg, (void *)1),
BT_GATT_CUD             ("reg_recv", BT_GATT_PERM_READ),
BT_GATT_CHARACTERISTIC  (BT_UUID_DECLARE_16(0x2A56), BT_GATT_CHRC_READ | BT_GATT_CHRC_WRITE_WITHOUT_RESP, BT_GATT_PERM_WRITE, NULL, demorun, (void *)1),
BT_GATT_CUD             ("demorun", BT_GATT_PERM_READ),
);


BT_GATT_SERVICE_DEFINE 
(
service_helloworld,
BT_GATT_PRIMARY_SERVICE (&service_helloworld_uuid),
BT_GATT_CHARACTERISTIC  (BT_UUID_DECLARE_16(0x2A56),BT_GATT_CHRC_READ | BT_GATT_CHRC_WRITE_WITHOUT_RESP,BT_GATT_PERM_WRITE, NULL, led_recv, (void *)1),
BT_GATT_CUD             ("LED", BT_GATT_PERM_READ),
BT_GATT_CHARACTERISTIC  (BT_UUID_DECLARE_16(0x2A56), BT_GATT_CHRC_NOTIFY,BT_GATT_PERM_READ, NULL, NULL, &but_val),
BT_GATT_CCC             (mpu_ccc_cfg_changed, BT_GATT_PERM_READ | BT_GATT_PERM_WRITE),
BT_GATT_CUD             ("Button", BT_GATT_PERM_READ),
);

//BT_GATT_CCC             (mpu_ccc_cfg_changed, BT_GATT_PERM_READ | BT_GATT_PERM_WRITE)


static void bt_ready (int err)
{
	LOG_INF ("Bluetooth initialized");
	/* Start advertising */
	__ASSERT (err == 0, "Advertising failed to start (err %d)", err);
	err = bt_le_adv_start(BT_LE_ADV_CONN, ad, ARRAY_SIZE(ad), NULL, 0);
	__ASSERT (err == 0, "Advertising failed to start (err %d)", err);
	LOG_INF ("Configuration mode: waiting connections...");
}


static void connected(struct bt_conn *connected, u8_t err)
{
	if (err)
	{
		LOG_ERR("Connection failed (err %u)", err);
	}
	else
	{
		LOG_INF("Connected");
		if (!conn)
		{
			conn = bt_conn_ref(connected);
		}
	}
}


static void disconnected(struct bt_conn *disconn, u8_t reason)
{
	if (conn)
	{
		bt_conn_unref(conn);
		conn = NULL;
	}
	LOG_INF("Disconnected (reason %u)", reason);
}


static struct bt_conn_cb conn_callbacks =
{
	.connected = connected,
	.disconnected = disconnected,
};


static struct gpio_callback button_0_cb;
static struct gpio_callback button_1_cb;
static struct gpio_callback button_2_cb;



void button_0_pressed (struct device * gpio, struct gpio_callback * cb, u32_t pins)
{
	printf ("button_pressed %i %x\n", gpio_pin_get (gpio, DT_GPIO_KEYS_BUTTON_0_GPIOS_PIN), pins);
	if (pins & BIT(DT_GPIO_KEYS_BUTTON_0_GPIOS_PIN))
	{
		if (gpio_pin_get (gpio, DT_GPIO_KEYS_BUTTON_0_GPIOS_PIN))
		{
			cmd = APP_CMD_FORWARD;
		}
		else
		{
			cmd = APP_CMD_STANDSTILL;
		}
	}

	if (pins & BIT(DT_GPIO_KEYS_BUTTON_1_GPIOS_PIN))
	{
		if (gpio_pin_get (gpio, DT_GPIO_KEYS_BUTTON_1_GPIOS_PIN))
		{
			cmd = APP_CMD_BACKWARD;
		}
		else
		{
			cmd = APP_CMD_STANDSTILL;
		}
	}


	/*
	tmc2130_write (&tmc, WRITE_FLAG|REG_CHOPCONF,   0x00008008UL); //native 256 microsteps, MRES=0, TBL=1=24, TOFF=8
	tmc2130_set_en (&tmc, 0);
	tmc2130_set_dir (&tmc, 0);
	*/
}


void button_1_pressed (struct device * gpio, struct gpio_callback * cb, u32_t pins)
{
	printf ("button_1_pressed\n");
}


void button_2_pressed (struct device * gpio, struct gpio_callback * cb, u32_t pins)
{
	printf ("button_2_pressed\n");
}



void main(void)
{
	int ret;
	tmc2130_init (&tmc);
	tmc2130_info_status (0x00);

	//ret = button_init();

	led_init();
	bt_conn_cb_register (&conn_callbacks);
	ret = bt_enable (bt_ready);
	__ASSERT (ret == 0, "Bluetooth bt_enable failed (err %d)", ret);

	tmc2130_write (&tmc, WRITE_FLAG|REG_GCONF,      0x00000001UL); //voltage on AIN is current reference
	tmc2130_write (&tmc, WRITE_FLAG|REG_IHOLD_IRUN, 0x00001010UL); //IHOLD=0x10, IRUN=0x10
	tmc2130_write (&tmc, WRITE_FLAG|REG_CHOPCONF,   0x00008008UL); //native 256 microsteps, MRES=0, TBL=1=24, TOFF=8
	int8_t a = -64;
	printf ("REG_COOLCONF  0x%02X 0x%08lx\n", REG_COOLCONF, ((uint32_t)a << TMC2130_COOLCONF_SGT_BITPOS) & TMC2130_COOLCONF_SGT_MASK);
	tmc2130_write (&tmc, WRITE_FLAG|REG_COOLCONF,   ((uint32_t)a << TMC2130_COOLCONF_SGT_BITPOS) & TMC2130_COOLCONF_SGT_MASK);
	tmc2130_set_en (&tmc, 1);



	struct device * button_0 = device_get_binding (DT_GPIO_KEYS_BUTTON_0_GPIOS_CONTROLLER);
	__ASSERT (button_0, "device_get_binding failed");
	struct device * button_1 = device_get_binding (DT_GPIO_KEYS_BUTTON_1_GPIOS_CONTROLLER);
	__ASSERT (button_1, "device_get_binding failed");
	struct device * button_2 = device_get_binding (DT_GPIO_KEYS_BUTTON_2_GPIOS_CONTROLLER);
	__ASSERT (button_2, "device_get_binding failed");
	ret = gpio_pin_configure (button_0, DT_GPIO_KEYS_BUTTON_0_GPIOS_PIN, DT_GPIO_KEYS_BUTTON_0_GPIOS_FLAGS | GPIO_INPUT);
	__ASSERT (ret == 0, "gpio_pin_configure failed (err %d)", ret);
	ret = gpio_pin_configure (button_1, DT_GPIO_KEYS_BUTTON_1_GPIOS_PIN, DT_GPIO_KEYS_BUTTON_1_GPIOS_FLAGS | GPIO_INPUT);
	__ASSERT (ret == 0, "gpio_pin_configure failed (err %d)", ret);
	ret = gpio_pin_configure (button_2, DT_GPIO_KEYS_BUTTON_2_GPIOS_PIN, DT_GPIO_KEYS_BUTTON_2_GPIOS_FLAGS | GPIO_INPUT);
	__ASSERT (ret == 0, "gpio_pin_configure failed (err %d)", ret);


	gpio_init_callback (&button_0_cb, button_0_pressed, BIT (DT_GPIO_KEYS_BUTTON_0_GPIOS_PIN));
	gpio_init_callback (&button_1_cb, button_0_pressed, BIT (DT_GPIO_KEYS_BUTTON_1_GPIOS_PIN));
	gpio_init_callback (&button_2_cb, button_0_pressed, BIT (DT_GPIO_KEYS_BUTTON_2_GPIOS_PIN));
	gpio_add_callback (button_0, &button_0_cb);
	gpio_add_callback (button_1, &button_1_cb);
	gpio_add_callback (button_2, &button_2_cb);
	ret = gpio_pin_interrupt_configure (button_0, DT_GPIO_KEYS_BUTTON_0_GPIOS_PIN, GPIO_INT_EDGE_BOTH);
	__ASSERT (ret == 0, "gpio_pin_interrupt_configure failed (err %d)", ret);
	ret = gpio_pin_interrupt_configure (button_1, DT_GPIO_KEYS_BUTTON_1_GPIOS_PIN, GPIO_INT_EDGE_BOTH);
	__ASSERT (ret == 0, "gpio_pin_interrupt_configure failed (err %d)", ret);
	ret = gpio_pin_interrupt_configure (button_2, DT_GPIO_KEYS_BUTTON_2_GPIOS_PIN, GPIO_INT_EDGE_BOTH);
	__ASSERT (ret == 0, "gpio_pin_interrupt_configure failed (err %d)", ret);

	u32_t stepper_data;
	u8_t stepper_status;
	while (1)
	{
		k_sleep (K_MSEC(1));
		//tmc2130_set_en (&tmc, 1);
		/*
		u32_t data1;
		u32_t data2;
		u8_t s;
		s = tmc2130_read (&tmc, REG_CHOPCONF, &data1);
		printf ("REG_CHOPCONF  0x%02X 0x%08X\n", s, data1);
		s = tmc2130_read (&tmc, REG_GSTAT, &data1);
		printf ("REG_GSTAT     0x%02X 0x%08X\n", s, data1);
		s = tmc2130_read (&tmc, REG_DRVSTATUS, &data2);
		printf ("REG_DRVSTATUS 0x%02X 0x%08X\n", s, data2);
		tmc2130_info_DRVSTATUS (data2);
		*/

		//tmc2130_set_en (&tmc, 0);
		//tmc2130_info_drv_status (data2);
		//tmc2130_write (&tmc, WRITE_FLAG|REG_CHOPCONF, 0x00008008UL);
		//tmc2130_set_en (&tmc, 1);


		switch (cmd)
		{
		case APP_CMD_DEMORUN:
			tmc2130_write (&tmc, WRITE_FLAG|REG_CHOPCONF,   0x00008008UL); //native 256 microsteps, MRES=0, TBL=1=24, TOFF=8
			tmc2130_set_en (&tmc, 0);
			tmc2130_set_dir (&tmc, 0);
			k_sleep (K_SECONDS(4));
			tmc2130_write (&tmc, WRITE_FLAG|REG_CHOPCONF,   0x00008008UL); //native 256 microsteps, MRES=0, TBL=1=24, TOFF=8
			tmc2130_set_en (&tmc, 0);
			tmc2130_set_dir (&tmc, 1);
			k_sleep (K_SECONDS(4));
			cmd = APP_CMD_STANDSTILL;
			break;
		case APP_CMD_FORWARD:
			printf ("APP_CMD_FORWARD\n");
			stepper_status = tmc2130_read (&tmc, REG_DRVSTATUS, &stepper_data);
			tmc2130_info_status (stepper_status);
			tmc2130_info_DRVSTATUS (stepper_data);
			tmc2130_write (&tmc, WRITE_FLAG|REG_CHOPCONF,   0x00008008UL); //native 256 microsteps, MRES=0, TBL=1=24, TOFF=8
			tmc2130_set_en (&tmc, 0);
			tmc2130_set_dir (&tmc, 0);
			cmd = APP_CMD_CONTINUE;
			break;
		case APP_CMD_BACKWARD:
			printf ("APP_CMD_BACKWARD\n");
			stepper_status = tmc2130_read (&tmc, REG_DRVSTATUS, &stepper_data);
			tmc2130_info_status (stepper_status);
			tmc2130_info_DRVSTATUS (stepper_data);
			tmc2130_write (&tmc, WRITE_FLAG|REG_CHOPCONF,   0x00008008UL); //native 256 microsteps, MRES=0, TBL=1=24, TOFF=8
			tmc2130_set_en (&tmc, 0);
			tmc2130_set_dir (&tmc, 1);
			cmd = APP_CMD_CONTINUE;
			break;
		case APP_CMD_STANDSTILL:
			printf ("APP_CMD_STANDSTILL\n");
			tmc2130_set_en (&tmc, 1);
			cmd = APP_CMD_CONTINUE;
			break;
		case APP_CMD_CONTINUE:
			break;
		}

	}
}
```

## src/button_svc.c
```c
#include <zephyr/types.h>
#include <stddef.h>
#include <string.h>
#include <errno.h>
#include <sys/printk.h>
#include <sys/byteorder.h>
#include <zephyr.h>
#include <drivers/gpio.h>
#include <logging/log.h>

#include <bluetooth/bluetooth.h>
#include <bluetooth/hci.h>
#include <bluetooth/conn.h>
#include <bluetooth/uuid.h>
#include <bluetooth/gatt.h>
#include "button_svc.h"


#include <devicetree.h>

LOG_MODULE_REGISTER(button_svc);

#define BUT_PORT    DT_ALIAS_SW0_GPIOS_CONTROLLER
#define BUT_PIN     DT_ALIAS_SW0_GPIOS_PIN

extern struct bt_conn *conn;
extern struct bt_gatt_service_static service_helloworld[];
extern volatile bool notify_enable;

static struct device *button_dev;
static struct gpio_callback gpio_cb;
u16_t but_val;

void button_pressed (struct device *gpiob, struct gpio_callback *cb, u32_t pins)
{
	int err;
	if (conn == NULL)
	{
		LOG_INF("BLE not connected");
		return;
	}
	LOG_INF("Button SW1 pressed");
	if (notify_enable == false)
	{
		LOG_INF("Notify not enabled");
		return;
	}
	err = bt_gatt_notify(NULL, &service_helloworld->attrs[2], &but_val, sizeof(but_val));
	if (err)
	{
		LOG_ERR("Notify error: %d", err);
		return;
	}
	LOG_INF("Send notify ok");
	but_val = (but_val == 0) ? 0x100 : 0;
}

int button_init(void)
{
	int ret;
	button_dev = device_get_binding(BUT_PORT);
	if (!button_dev)
	{
		return (-EOPNOTSUPP);
	}

	ret = gpio_pin_configure(button_dev, BUT_PIN, DT_ALIAS_SW0_GPIOS_FLAGS | GPIO_INPUT);
	if (ret != 0)
	{
		LOG_ERR("Error %d: failed to configure pin %d '%s'\n",ret, BUT_PIN, DT_ALIAS_SW0_LABEL);
		return ret;
	}

	gpio_init_callback(&gpio_cb, button_pressed,BIT(BUT_PIN));
	gpio_add_callback(button_dev, &gpio_cb);
	ret = gpio_pin_interrupt_configure(button_dev, BUT_PIN,GPIO_INT_EDGE_TO_ACTIVE);
	if (ret != 0)
	{
		LOG_ERR("Error %d: failed to configure interrupt on pin %d '%s'\n", ret, BUT_PIN, DT_ALIAS_SW0_LABEL);
		return ret;
	}
	but_val = 0;
	return 0;
}
```

## src/button_svc.h
```c
int button_init(void);
```

## src/led_svc.c
```c
#include <zephyr/types.h>
#include <stddef.h>
#include <string.h>
#include <errno.h>
#include <sys/printk.h>
#include <sys/byteorder.h>
#include <zephyr.h>
#include <drivers/gpio.h>
#include <logging/log.h>

#include <devicetree.h>
#include "led_svc.h"

LOG_MODULE_REGISTER(led_svc);

#define LED_PORT DT_ALIAS_LED0_GPIOS_CONTROLLER
#define LED      DT_ALIAS_LED0_GPIOS_PIN

struct device *led_dev;


ssize_t led_recv (struct bt_conn *conn, const struct bt_gatt_attr *attr, const void *buf, u16_t len, u16_t offset, u8_t flags)
{
	if (led_dev == NULL)
	{
		LOG_ERR ("Error: no LED device");
	}
	gpio_pin_toggle (led_dev, LED);
	return 0;
}

int led_init(void)
{
	int ret;
	led_dev = device_get_binding (LED_PORT);
	if (led_dev == NULL)
	{
		LOG_ERR ("Error device_get_binding: failed to get device '%s'\n", LED_PORT);
		return (-EOPNOTSUPP);
	}
	ret = gpio_pin_configure (led_dev, LED,GPIO_OUTPUT_ACTIVE | DT_ALIAS_LED0_GPIOS_FLAGS);
	if (ret < 0)
	{
		LOG_ERR ("Error %d: failed to configure pin %d '%s'\n", ret, LED, DT_ALIAS_LED0_LABEL);
		return ret;
	}
	return 0;
}
```

## src/led_svc.h
```c
#include <zephyr/types.h>
#include <stddef.h>
#include <string.h>
#include <errno.h>
#include <sys/printk.h>
#include <sys/byteorder.h>
#include <sys/util.h>
#include <zephyr.h>
#include <devicetree.h>
#include <drivers/gpio.h>
#include <logging/log.h>
#include <device.h>
#include <drivers/pwm.h>
#include <logging/log.h>

#include <bluetooth/bluetooth.h>
#include <bluetooth/hci.h>
#include <bluetooth/conn.h>
#include <bluetooth/uuid.h>
#include <bluetooth/gatt.h>


ssize_t led_recv (struct bt_conn *conn, const struct bt_gatt_attr *attr, const void *buf, u16_t len, u16_t offset, u8_t flags);

int led_init(void);
```

## src/tmc2130.c
```c
#include <sys/__assert.h>
#include "tmc2130.h"

LOG_MODULE_REGISTER(tmc2130);

struct device * tmc2130_get_dev (char const * name)
{
	struct device * dev;
	dev = device_get_binding (name);
	if (dev == NULL)
	{
		LOG_INF ("Cannot find device %s", name);
		return NULL;
	}
	else
	{
		LOG_INF ("Found device %s", name);
	}
	return dev;
}


void tmc2130_info_status (u8_t s)
{
	printf ("%sreset|", (s & TMC2130_RESET_FLAG)?ANSI_COLOR_GREEN:ANSI_COLOR_RED);
	printf ("%serror|", (s & TMC2130_DRIVER_ERROR)?ANSI_COLOR_GREEN:ANSI_COLOR_RED);
	printf ("%ssg2|", (s & TMC2130_SG2)?ANSI_COLOR_GREEN:ANSI_COLOR_RED);
	printf ("%sstandstill", (s & TMC2130_STANDSTILL)?ANSI_COLOR_GREEN:ANSI_COLOR_RED);
	printf (ANSI_COLOR_RESET"\n");
}


void tmc2130_info_DRVSTATUS (u32_t s)
{
	printf ("%sstst|", (s & TMC2130_DRVSTATUS_STST)?ANSI_COLOR_GREEN:ANSI_COLOR_RED);
	printf ("%solb|", (s & TMC2130_DRVSTATUS_OLB)?ANSI_COLOR_GREEN:ANSI_COLOR_RED);
	printf ("%sola|", (s & TMC2130_DRVSTATUS_OLA)?ANSI_COLOR_GREEN:ANSI_COLOR_RED);
	printf ("%ss2gb|", (s & TMC2130_DRVSTATUS_S2GB)?ANSI_COLOR_GREEN:ANSI_COLOR_RED);
	printf ("%ss2ga|", (s & TMC2130_DRVSTATUS_S2GA)?ANSI_COLOR_GREEN:ANSI_COLOR_RED);
	printf ("%sotpw|", (s & TMC2130_DRVSTATUS_OTPW)?ANSI_COLOR_GREEN:ANSI_COLOR_RED);
	printf ("%sStallGuard|", (s & TMC2130_DRVSTATUS_STALLGUARD)?ANSI_COLOR_GREEN:ANSI_COLOR_RED);
	printf ("%sfsactive|", (s & TMC2130_DRVSTATUS_FSACTIVE)?ANSI_COLOR_GREEN:ANSI_COLOR_RED);
	printf (ANSI_COLOR_RESET);
	printf ("CSACTUAL%lu|", (s & TMC2130_DRVSTATUS_CSACTUAL_MASK) >> TMC2130_DRVSTATUS_CSACTUAL_BITPOS);
	printf ("SGRESULT%lu", (s & TMC2130_DRVSTATUS_SGRESULT_MASK) >> TMC2130_DRVSTATUS_SGRESULT_BITPOS);
	printf ("\n");
}


u8_t tmc2130_tansfer (struct tmc2130 * dev, u8_t data_tx)
{
	u8_t data_rx;
	struct spi_buf buf_tx[] = {{.buf = &data_tx,.len = sizeof(data_tx)}};
	struct spi_buf buf_rx[] = {{.buf = &data_rx,.len = sizeof(data_rx)}};
	struct spi_buf_set tx = {.buffers = buf_tx, .count = 1};
	struct spi_buf_set rx = {.buffers = buf_rx, .count = 1};
	spi_transceive (dev->dev_spi, &dev->spi_cfg, &tx, &rx);
	return data_rx;
}


u8_t tmc2130_write (struct tmc2130 * dev, u8_t cmd, u32_t data)
{
	//LOG_INF ("tmc2130_write 0x%02x 0x%08x", cmd, data);
	uint8_t s;
	gpio_pin_set (dev->dev_gpio_cs, TMC2130_CS_PIN, 0);
	s = tmc2130_tansfer (dev, cmd);
	tmc2130_tansfer (dev, (data >> 24UL) & 0xFF) & 0xFF;
	tmc2130_tansfer (dev, (data >> 16UL) & 0xFF) & 0xFF;
	tmc2130_tansfer (dev, (data >>  8UL) & 0xFF) & 0xFF;
	tmc2130_tansfer (dev, (data >>  0UL) & 0xFF) & 0xFF;
	gpio_pin_set (dev->dev_gpio_cs, TMC2130_CS_PIN, 1);
	return s;
}


u8_t tmc2130_read (struct tmc2130 * dev, u8_t cmd, u32_t * data)
{
	uint8_t s;
	tmc2130_write (dev, cmd, 0UL); //set read address
	gpio_pin_set (dev->dev_gpio_cs, TMC2130_CS_PIN, 0);
	s = tmc2130_tansfer (dev, cmd);
	*data  = tmc2130_tansfer (dev, 0x00) & 0xFF;
	*data <<= 8;
	*data |= tmc2130_tansfer (dev, 0x00) & 0xFF;
	*data <<= 8;
	*data |= tmc2130_tansfer (dev, 0x00) & 0xFF;
	*data <<= 8;
	*data |= tmc2130_tansfer (dev, 0x00) & 0xFF;
	gpio_pin_set (dev->dev_gpio_cs, TMC2130_CS_PIN, 1);
	return s;
}



/*
u8_t tmc2130_write (struct tmc2130 * dev, u8_t cmd, u32_t data)
{
	//TMC2130 MSB big-endian
	u8_t s;
	//data = sys_cpu_to_be32 (data);
	gpio_pin_set (dev->dev_gpio_cs, TMC2130_CS_PIN, 0);
	struct spi_buf bufs_tx[] =
	{
	{
		.buf = &cmd,
		.len = sizeof(cmd)
	},
	{
		.buf = &data,
		.len = sizeof(data)
	}
};
	struct spi_buf bufs_rx[] =
	{
	{
		.buf = &s,
		.len = sizeof(s)
	}};
	struct spi_buf_set tx =
	{
		.buffers = bufs_tx,
		.count = 2
	};
	struct spi_buf_set rx =
	{
		.buffers = bufs_rx,
		.count = 1
	};
	spi_transceive (dev->dev_spi, &dev->spi_cfg, &tx, &rx);
	gpio_pin_set (dev->dev_gpio_cs, TMC2130_CS_PIN, 1);
	LOG_INF ("Write %08x %08x => %02x", cmd, data, s);
	tmc2130_info_status (s);
	return s;
}

u8_t tmc2130_read (struct tmc2130 * dev, u8_t cmd, u32_t * data)
{
	tmc2130_write (dev, cmd, 0);
	u8_t s;
	gpio_pin_set (dev->dev_gpio_cs, TMC2130_CS_PIN, 0);
	struct spi_buf bufs_tx[] =
	{
	{
		.buf = &cmd,
		.len = sizeof(cmd)
	}
};
	struct spi_buf bufs_rx[] =
	{
	{
		.buf = &s,
		.len = sizeof(s)
	},
	{
		.buf = &data,
		.len = sizeof(data)
	}
};
	struct spi_buf_set tx =
	{
		.buffers = bufs_tx,
		.count = 1
	};
	struct spi_buf_set rx =
	{
		.buffers = bufs_rx,
		.count = 2
	};
	spi_transceive (dev->dev_spi, &dev->spi_cfg, &tx, &rx);
	gpio_pin_set (dev->dev_gpio_cs, TMC2130_CS_PIN, 1);
	*data = sys_be32_to_cpu (*data);
	LOG_INF ("Read %08x => %08x %02x", cmd, *data, s);
	tmc2130_info_status (s);
	return s;
}
*/

void tmc2130_set_period (struct tmc2130 * dev, u32_t period)
{
	int r;
	r = pwm_pin_set_usec (dev->dev_pwm_step, 1, period, dev->pulse, 0);
	__ASSERT (r == 0, "pwm_pin_set_usec period (%u), pulse (%u) failed", period, dev->pulse);
	dev->period = period;
}


void tmc2130_set_pulse (struct tmc2130 * dev, u32_t pulse)
{
	int r;
	r = pwm_pin_set_usec (dev->dev_pwm_step, 1, dev->period, pulse, 0);
	__ASSERT (r == 0, "pwm_pin_set_usec pulse (%u), period (%u) failed", pulse, dev->period);
	dev->pulse = pulse;
}


void tmc2130_set_dir (struct tmc2130 * dev, int value)
{
	int r;
	if (value)
	{
		r = gpio_pin_set (dev->dev_gpio_dir, TMC2130_DIR_PIN, 1);
		__ASSERT (r == 0, "gpio_pin_set failed (err %u)", r);
		dev->flags |= TMC2130_DIR_FLAG;
	}
	else
	{
		r = gpio_pin_set (dev->dev_gpio_dir, TMC2130_DIR_PIN, 0);
		__ASSERT (r == 0, "gpio_pin_set failed (err %u)", r);
		dev->flags &= ~TMC2130_DIR_FLAG;
	}
}


void tmc2130_set_en (struct tmc2130 * dev, int value)
{
	int r;
	if (value)
	{
		r = gpio_pin_set (dev->dev_gpio_en, TMC2130_EN_PIN, 1);
		__ASSERT (r == 0, "gpio_pin_set failed (err %u)", r);
		dev->flags |= TMC2130_EN_FLAG;
	}
	else
	{
		r = gpio_pin_set (dev->dev_gpio_en, TMC2130_EN_PIN, 0);
		__ASSERT (r == 0, "gpio_pin_set failed (err %u)", r);
		dev->flags &= ~TMC2130_EN_FLAG;

	}
}


void tmc2130_init (struct tmc2130 * dev)
{
	int r;
	dev->period = PERIOD;
	dev->pulse = PULSEWIDTH;
	dev->dev_pwm_step = device_get_binding (TMC2130_STEP_DEV);
	__ASSERT (dev->dev_pwm_step, "device_get_binding failed");
	dev->dev_gpio_dir = device_get_binding (TMC2130_DIR_PORT);
	__ASSERT (dev->dev_gpio_dir, "device_get_binding failed");
	dev->dev_gpio_en = device_get_binding (TMC2130_EN_PORT);
	__ASSERT (dev->dev_gpio_en, "device_get_binding failed");
	dev->dev_gpio_cs = device_get_binding (TMC2130_CS_PORT);
	__ASSERT (dev->dev_gpio_cs, "device_get_binding failed");
	dev->dev_spi = device_get_binding (TMC2130_SPI_DEV);
	__ASSERT (dev->dev_spi, "device_get_binding failed");
	r = pwm_pin_set_usec (dev->dev_pwm_step, 1, dev->period, dev->pulse, 0);
	__ASSERT (r == 0, "pwm_pin_set_usec failed (err %u)", r);
	r = gpio_pin_configure (dev->dev_gpio_dir, TMC2130_DIR_PIN, GPIO_OUTPUT_INACTIVE);
	__ASSERT (r == 0, "gpio_pin_configure failed (err %u)", r);
	r = gpio_pin_configure (dev->dev_gpio_en, TMC2130_EN_PIN, GPIO_OUTPUT_ACTIVE);
	__ASSERT (r == 0, "gpio_pin_configure failed (err %u)", r);
	r = gpio_pin_configure (dev->dev_gpio_cs, TMC2130_CS_PIN, GPIO_OUTPUT_ACTIVE);
	__ASSERT (r == 0, "gpio_pin_configure failed (err %u)", r);
	dev->spi_cfg.operation = SPI_WORD_SET(8) | SPI_MODE_CPOL | SPI_MODE_CPHA | SPI_TRANSFER_MSB;
	dev->spi_cfg.frequency = 1000000;
	//uint32_t data = 0;
	//tmc_read (dev, REG_DRVSTATUS, &data);
	//tmc_read (dev, REG_GSTAT, &data);
}
```

## src/tmc2130.h
```c
#include <stddef.h>
#include <string.h>
#include <stdio.h>
#include <errno.h>

#include <zephyr.h>
#include <zephyr/types.h>

#include <sys/printk.h>
#include <sys/byteorder.h>
#include <sys/util.h>

#include <devicetree.h>

#include <device.h>

#include <logging/log.h>

#include <drivers/pwm.h>
#include <drivers/spi.h>
#include <drivers/gpio.h>

#include <bluetooth/bluetooth.h>
#include <bluetooth/hci.h>
#include <bluetooth/conn.h>
#include <bluetooth/uuid.h>
#include <bluetooth/gatt.h>

//TMC2130 pin STEP ---yellow--- (PA0,A3,15)
#define TMC2130_STEP_DEV "PWM_2"
#define TMC2130_STEP_PIN 0
#define TMC2130_STEP_PORT "GPIOA"

//#define PERIOD (USEC_PER_SEC / 50U)
#define PERIOD 40
#define PULSEWIDTH 1

//TMC2130 pin DIR ---orange--- (PA2,D1,17)
#define TMC2130_DIR_PORT "GPIOA"
#define TMC2130_DIR_PIN 2

//TMC2130 pin EN ---brown--- (PC6,D2,50)
#define TMC2130_EN_PORT "GPIOC"
#define TMC2130_EN_PIN 6

//TMC2130 pin CS ---blue--- (PA10,D3,51)
#define TMC2130_CS_PORT "GPIOA"
#define TMC2130_CS_PIN 10

#define TMC2130_SPI_DEV "SPI_1"

//TMC2130 pin CSK --orange--- (PA5,D13,20,SCK)
#define TMC2130_SCK_PORT "GPIOA"
#define TMC2130_SCK_PIN 5

//TMC2130 pin SDO --yellow--- (PA6,D12,21,MISO)
#define TMC2130_SDO_PORT "GPIOA"
#define TMC2130_SDO_PIN 6

//TMC2130 pin SDI --green--- (PA7,D11,22,MOSI)
#define TMC2130_SDI_PORT "GPIOA"
#define TMC2130_SDI_PIN 7



#define WRITE_FLAG     (1<<7) //write flag
#define READ_FLAG      (0<<7) //read flag
#define REG_GCONF      0x00
#define REG_GSTAT      0x01
#define REG_IHOLD_IRUN 0x10
#define REG_CHOPCONF   0x6C
#define REG_COOLCONF   0x6D // W, n=25, CoolStep smart current control register and StallGuard2 configuration.
#define REG_DCCTRL     0x6E // W, n=24, DcStep(DC) automatic commutation configuration register
#define REG_DRVSTATUS  0x6F // R, n=32, StallGuard2 value and driver error flags

#define ANSI_COLOR_RED     "\x1b[31m"
#define ANSI_COLOR_GREEN   "\x1b[32m"
#define ANSI_COLOR_YELLOW  "\x1b[33m"
#define ANSI_COLOR_BLUE    "\x1b[34m"
#define ANSI_COLOR_MAGENTA "\x1b[35m"
#define ANSI_COLOR_CYAN    "\x1b[36m"
#define ANSI_COLOR_RESET   "\x1b[0m"

#define TMC2130_RESET_FLAG 0x01
#define TMC2130_DRIVER_ERROR 0x02
#define TMC2130_SG2 0x04
#define TMC2130_STANDSTILL 0x08

#define TMC2130_DRVSTATUS_STST       (1U << 31)
#define TMC2130_DRVSTATUS_OLB        (1U << 30)
#define TMC2130_DRVSTATUS_OLA        (1U << 29)
#define TMC2130_DRVSTATUS_S2GB       (1U << 28)
#define TMC2130_DRVSTATUS_S2GA       (1U << 27)
#define TMC2130_DRVSTATUS_OTPW       (1U << 26)
#define TMC2130_DRVSTATUS_OT         (1U << 25)
#define TMC2130_DRVSTATUS_STALLGUARD (1U << 24)
#define TMC2130_DRVSTATUS_FSACTIVE   (1U << 15)
#define TMC2130_DRVSTATUS_SGRESULT_BITPOS 0
#define TMC2130_DRVSTATUS_SGRESULT_MASK 0x3FFUL
#define TMC2130_DRVSTATUS_CSACTUAL_BITPOS 16
#define TMC2130_DRVSTATUS_CSACTUAL_MASK 0x3FFUL

#define TMC2130_COOLCONF_SFILT (1U << 24)
#define TMC2130_COOLCONF_SGT_BITPOS 16
#define TMC2130_COOLCONF_SGT_MASK 0x7F0000UL





#define TMC2130_EN_FLAG 0x01
#define TMC2130_DIR_FLAG 0x02

struct tmc2130
{
	struct device * dev_pwm_step;
	struct device * dev_gpio_dir;
	struct device * dev_gpio_en;
	struct device * dev_gpio_cs;
	struct device * dev_spi;
	struct spi_config spi_cfg;
	u32_t period;
	u32_t pulse;
	u8_t flags;
};

struct device * tmc2130_get_dev (char const * name);



void tmc2130_info_status (u8_t s);
void tmc2130_info_DRVSTATUS (u32_t s);

u8_t tmc2130_write (struct tmc2130 * dev, u8_t cmd, u32_t data);

u8_t tmc2130_read (struct tmc2130 * dev, u8_t cmd, u32_t * data);

void tmc2130_init (struct tmc2130 * dev);

void tmc2130_set_period (struct tmc2130 * dev, u32_t period);
void tmc2130_set_pulse (struct tmc2130 * dev, u32_t pulse);
void tmc2130_set_en (struct tmc2130 * dev, int value);
void tmc2130_set_dir (struct tmc2130 * dev, int value);
```
